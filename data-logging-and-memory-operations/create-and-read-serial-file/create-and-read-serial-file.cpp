/**
 * Author: Edwin Mwiti 
 * Email: emwiti658@gmail.com
 * Date: 6th June 2024
 * 
 * This file implements readin and writing from a SPI flash
 * chip
 * We read random data from the serial, put it into a buffer and dump it into a file in 
 * the SPI flash memory
 * 
 * We use the ESP32-Devkit module here with the CS pin as pin 5
 * 
 * Functions for formatting the SPI flash are also included, with an LED 
 * to indicate when the flash is formatting
 * The led blinks at 20 Hz when formatting and then remains lit continously 
 * after formatting is done
 * 
 */

#include <SPI.h>
#include <SerialFlash.h>


// this struct will hold the data generated by serial
struct flight_data {
  float ax;
  float ay;
  int32_t alt;
};

struct flight_data dummy_data;

// file with a size of 4KB
char filename[15] = "log.bin";
uint32_t file_size = 8192; // size in bytes

// change the CS_PIN to the pin being used as chip select
#define CS_PIN 5
#define FLASH_LED 4

bool initFlash() {
  if(!SerialFlash.begin(CS_PIN)) {
    return false;
  }

  return true;
  
}

void formatFlash() {
  Serial.println("Formatting flash memory...");
  uint8_t id[5];
  SerialFlash.readID(id);
  SerialFlash.eraseAll();

  // blink the led at 10Hz while formatting
  while(!SerialFlash.ready()) {
    digitalWrite(FLASH_LED, HIGH);
    delay(100);
    digitalWrite(FLASH_LED, LOW);
    delay(100);
  }

  // remain solid lit once done formatting
  digitalWrite(FLASH_LED, HIGH);
  
}

void initFlashLED() {
  pinMode(FLASH_LED, OUTPUT);
}

// generate dummy data from serial
void generateDummyData() {
  long randNumber1 = random(300); 
  dummy_data.ax = randNumber1;

  long randNumber2 = random(100); 
  dummy_data.ay = randNumber2;

  long randNumber3 = random(250); 
  dummy_data.alt = randNumber3;  
  
}

void setup() {
  Serial.begin(115200);

  // init the flash indicator LED
  initFlashLED();

  // initialize the flash memory
  int flash_init_flag = initFlash();

  // create a file
  if(flash_init_flag) {

    // start by formatting the flash memory
    formatFlash();
    
    // TODO: update system check table
    Serial.println("Flash memory init success");

    // create file on flash memory
    if(SerialFlash.createErasable(filename, file_size)) {
      Serial.println("File created successfully");
    } else {
      Serial.println("Failed to create file");
    }
  }

  // to generate random data 
  // pin 13 should be unconnected for this to work
  randomSeed(analogRead(13));
  
}

void loop() {
   // generate fake serial data
//   generateDummyData();

//   Serial.print(dummy_data.ax); Serial.print(",");
//   Serial.print(dummy_data.ay); Serial.print(",");
//   Serial.print(dummy_data.alt); Serial.println();

}
